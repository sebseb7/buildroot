## package/libreswan/Config.in
```kconfig
config BR2_PACKAGE_LIBRESWAN
	bool "libreswan"
	depends on BR2_USE_MMU # iproute2
	depends on BR2_TOOLCHAIN_HEADERS_AT_LEAST_3_4 # iproute2
	select BR2_PACKAGE_GMP
	select BR2_PACKAGE_LIBNSS
	select BR2_PACKAGE_LIBEVENT
	select BR2_PACKAGE_IPROUTE2
	select BR2_PACKAGE_LIBCURL
	select BR2_PACKAGE_LIBCAP_NG
	help
	  Libreswan is an implementation of IPsec for Linux

	  https://libreswan.org/

comment "libreswan needs a toolchain w/ headers >= 3.4"
	depends on BR2_USE_MMU
	depends on !BR2_TOOLCHAIN_HEADERS_AT_LEAST_3_4
```
